## tools/kconfig.py
```kconfig
#!/usr/bin/env python3
"""
tools/kconfig.py — sai.L99 declarative config processor.

Reads default config values from a Kconfig-like defaults file, merges
board config and user config (later wins), resolves dependencies in
declaration order, and emits include/generated/sai_config.h.

Config file syntax (sai.conf):
    # comment
    CONFIG_SAI_FOO=y          # enable
    CONFIG_SAI_BAR=n          # disable
    CONFIG_SAI_BAZ=42         # int
    CONFIG_SAI_QUX="arm"      # string

Dependency expressions in the defaults file (right-hand side only):
    config CONFIG_SAI_SLAB
        default y
        depends on CONFIG_SAI_HEAP

Processing:
    1. start with defaults
    2. apply board conf (if any)
    3. apply user conf  (overrides)
    4. drop configs whose dependencies are not satisfied
    5. emit #cmakedefine-style header with CONFIG_* macros
"""
import re
import sys

def parse_conf(path, values):
    try:
        text = open(path).read()
    except FileNotFoundError:
        return
    for line in text.splitlines():
        line = line.split('#', 1)[0].strip()
        if not line:
            continue
        m = re.match(r'(CONFIG_[A-Z0-9_]+)\s*=\s*(.+)', line)
        if m:
            values[m.group(1)] = m.group(2).strip().strip('"')

def parse_defaults(path):
    """Parse a defaults file: config entries with default/depends-on."""
    entries = []
    cur = None
    try:
        text = open(path).read()
    except FileNotFoundError:
        return entries
    for raw in text.splitlines():
        line = raw.split('#', 1)[0].strip()
        if not line:
            continue
        m = re.match(r'config\s+(CONFIG_[A-Z0-9_]+)$', line)
        if m:
            cur = {'name': m.group(1), 'default': 'n', 'depends': []}
            entries.append(cur)
            continue
        if cur is None:
            continue
        m = re.match(r'default\s+(.+)$', line)
        if m:
            cur['default'] = m.group(1).strip()
            continue
        m = re.match(r'depends\s+on\s+(.+)$', line)
        if m:
            cur['depends'].append(m.group(1).strip())
    return entries

def eval_dep(dep, values):
    """Evaluate 'CONFIG_A', '!CONFIG_A', 'CONFIG_A = y', '(expr) && (expr)'."""
    dep = dep.strip()
    dep = dep.strip('()')

    # split on top-level &&
    parts = re.split(r'\s*&&\s*', dep)
    for p in parts:
        p = p.strip()
        p = p.strip('()')
        if '||' in p:
            ok = any(eval_dep(x, values) for x in p.split('||'))
            if not ok:
                return False
            continue
        p = p.strip()
        neg = p.startswith('!')
        if neg:
            p = p[1:].strip()
        m = re.match(r'(CONFIG_[A-Z0-9_]+)\s*=\s*(.+)', p)
        if m:
            val = values.get(m.group(1), 'n')
            ok = (val == m.group(2).strip().strip('"'))
        else:
            val = values.get(p, 'n')
            ok = val not in ('n', '0', '')
        if neg:
            ok = not ok
        if not ok:
            return False
    return True

def coerce(raw):
    if raw in ('y', 'n'):
        return raw
    if re.match(r'^-?\d+$', raw) or re.match(r'^0[xX][0-9a-fA-F]+$', raw):
        return raw
    return f'"{raw.strip(chr(34))}"'

def main():
    if len(sys.argv) < 3:
        print(f"usage: {sys.argv[0]} defaults <inputs...> output.h", file=sys.stderr)
        sys.exit(2)
    defaults_file = sys.argv[1]
    output = sys.argv[-1]
    inputs = sys.argv[2:-1]

    values = {}
    entries = parse_defaults(defaults_file)
    for e in entries:
        values[e['name']] = coerce(e['default'])

    for path in inputs:
        parse_conf(path, values)

    # resolve dependencies: iterate until stable (max 16 passes)
    for _ in range(16):
        changed = False
        for e in entries:
            if e['name'] not in values:
                continue
            ok = all(eval_dep(d, values) for d in e['depends'])
            if not ok and values[e['name']] != 'n':
                values[e['name']] = 'n'
                changed = True
        if not changed:
            break

    lines = [
        "/** @file sai_config.h @brief GENERATED by tools/kconfig.py - do not edit. */",
        "#ifndef SAI_CONFIG_H",
        "#define SAI_CONFIG_H",
        "",
    ]
    for name in sorted(values):
        v = values[name]
        if v == 'y':
            lines.append(f"#define {name} 1")
        elif v == 'n':
            lines.append(f"#undef {name}")
        else:
            lines.append(f"#define {name} {v}")
    lines.append("")
    lines.append("#endif /* SAI_CONFIG_H */")
    lines.append("")

    import os
    os.makedirs(os.path.dirname(output) or '.', exist_ok=True)
    open(output, 'w').write("\n".join(lines))
    print(f"kconfig: wrote {output} ({len(values)} options)")

if __name__ == '__main__':
    main()
```
